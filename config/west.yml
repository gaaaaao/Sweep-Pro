## config/west.yml
```yaml
manifest:
  remotes:
  - name: zmkfirmware
    url-base: https://github.com/zmkfirmware
  - name: lynnlee0522
    url-base: https://github.com/lynnlee0522
  - name: nxtkb
    url-base: https://github.com/nxtkb
  - name: gaaaaao
    url-base: https://github.com/gaaaaao
  projects:
  - name: zmk
    remote: zmkfirmware
    revision: cb615aee9a7c427e251f2ab62080c1a44a165da9
    import: app/west.yml
  - name: zmk-vfx-sweep-pro-display
    remote: gaaaaao
    revision: 308e15cdb10d90ab5cb8ff4d42f2f6623f155fc4
  - name: zmk-behavior-report
    remote: nxtkb
    revision: 476f43da1f98b4a6150c9c0e499a257bd64a29a0
    import: west.yml
  - name: cirque-input-module
    remote: nxtkb
    revision: 8af03a4c061580c14ec8745caf0fa2dd3fc7f042
  self:
    path: config
```
